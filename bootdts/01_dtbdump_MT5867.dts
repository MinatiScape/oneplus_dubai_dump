/dts-v1/;

/ {
	#address-cells = <0x2>;
	#size-cells = <0x2>;
	compatible = "arm,foundation-arm", "arm,mt5867";
	interrupt-parent = <0x1>;
	model = "MT5867";

	AFEC_VSYNC {
		compatible = "AFEC_VSYNC";
		interrupts = <0x0 0x5c 0x4>;
	};

	AUDMA_V2_INTR {
		compatible = "AUDMA_V2_INTR";
		interrupts = <0x0 0x16 0x4>;
	};

	AU_DMA_BUFFER_INT_EDGE {
		compatible = "AU_DMA_BUFFER_INT_EDGE";
		interrupts = <0x0 0x61 0x4>;
	};

	AU_SPDIF_TX_CS_INT_0 {
		compatible = "AU_SPDIF_TX_CS_INT_0";
		interrupts = <0x0 0x77 0x4>;
	};

	AU_SPDIF_TX_CS_INT_1 {
		compatible = "AU_SPDIF_TX_CS_INT_1";
		interrupts = <0x0 0x78 0x4>;
	};

	DSP2MIPS_INT {
		compatible = "DSP2MIPS_INT";
		interrupts = <0x0 0x5f 0x4>;
	};

	DSP_MIU_PROT_intr {
		compatible = "DSP_MIU_PROT_intr";
		interrupts = <0x0 0x52 0x4>;
	};

	HDMI_NON_PCM_MODE_INT_OUT {
		compatible = "HDMI_NON_PCM_MODE_INT_OUT";
		interrupts = <0x0 0x4b 0x4>;
	};

	INT_CCFL {
		compatible = "INT_CCFL";
		interrupts = <0x0 0x59 0x4>;
	};

	MB_DSP2toMCU_INT_0 {
		compatible = "MB_DSP2toMCU_INT_0";
		interrupts = <0x0 0x46 0x4>;
	};

	MB_DSP2toMCU_INT_1 {
		compatible = "MB_DSP2toMCU_INT_1";
		interrupts = <0x0 0x47 0x4>;
	};

	MB_auR2toMCU_INT_0 {
		compatible = "MB_auR2toMCU_INT_0";
		interrupts = <0x0 0x44 0x4>;
	};

	MB_auR2toMCU_INT_1 {
		compatible = "MB_auR2toMCU_INT_1";
		interrupts = <0x0 0x45 0x4>;
	};

	Mstar-STR {

		Mstar-mbx {
			resume-stage1 = "noirq";
			suspend-stage1 = "noirq";
		};

		Mstar-utopia2k-str {
			policy = "async";
			resume-stage1 = "early";
			resume-stage1-waitfor = "mstar_mci.0";
			suspend-stage1 = "late";
		};

		mmcblk {
			resume-stage1 = "noirq";
			suspend-stage1 = "noirq";
		};

		mmcbus {
			resume-stage1 = "early";
			suspend-stage1 = "late";
		};

		mstar-xc {
			resume-stage1 = "noirq";
			suspend-stage1 = "noirq";
		};

		mstar_mci {
			policy = "async";
			resume-stage1 = "early";
			suspend-stage1 = "late";
		};
	};

	Mstar-ehci-1 {
		compatible = "Mstar-ehci-1";
	};

	Mstar-ehci-2 {
		compatible = "Mstar-ehci-2";
	};

	Mstar-ehci-3 {
		compatible = "Mstar-ehci-3";
	};

	Mstar-ehci-4 {
		compatible = "Mstar-ehci-4";
	};

	Mstar-lp-standby {
		compatible = "Mstar-lp-standby";
	};

	Mstar-otg {
		compatible = "Mstar-otg";
		interrupts = <0x0 0x6 0x4 0x0 0x7 0x4>;
	};

	Mstar-sys {

		firmware {

			audio {
				path = "/vendor/lib/utopia/audio_bin/";
			};

			vdec {
				path = "/vendor/lib/utopia/vdec_bin/";
			};

			vdec_fw {
				path = "/vendor/lib/utopia/vdec_bin/";
			};
		};
	};

	Mstar-udc {
		compatible = "Mstar-udc";
		interrupts = <0x0 0x16 0x4>;
	};

	Mstar-utopia2k-str {
		compatible = "Mstar-utopia2k-str";

		ace {

			resume {

				stage0 {
					post-condition = "ace";
					pre-condition = "xc";
				};
			};

			suspend {

				stage0 {
					post-condition = "ace";
				};
			};
		};

		avd {

			resume {

				stage0 {
					post-condition = "avd";
					pre-condition = "vif";
				};
			};
		};

		dmx {

			resume {

				stage0 {
					post-condition = "dmx";
					pre-condition = "dscmb";
				};
			};

			suspend {

				stage0 {
					post-condition = "dmx";
					pre-condition = "dscmb";
				};
			};
		};

		dscmb {

			resume {

				stage0 {
					post-condition = "dscmb";
				};
			};

			suspend {

				stage0 {
					post-condition = "dscmb";
				};
			};
		};

		hdmi_rx {

			resume {

				stage0 {
					post-condition = "hdmi_rx";
				};
			};
		};

		mhl {

			resume {

				stage0 {
					pre-condition = "hdmi_rx";
				};
			};
		};

		miu {

			resume {

				stage0 {
					post-condition = "miu";
				};
			};
		};

		mvop {

			resume {

				stage0 {
					post-condition = "mvop";
				};
			};
		};

		pnl {

			resume {

				stage0 {
					post-condition = "pnl";
				};
			};

			suspend {

				stage0 {
					pre-condition = "xc";
				};
			};
		};

		pq {

			resume {

				stage0 {
					post-condition = "pq";
					pre-condition = "xc";
				};
			};

			suspend {

				stage0 {
					post-condition = "pq";
				};
			};
		};

		vdec {

			resume {

				stage0 {
					post-condition = "vdec";
				};
			};
		};

		ve {

			resume {

				stage0 {
					pre-condition = "miu", "xc";
				};
			};
		};

		vif {

			resume {

				stage0 {
					post-condition = "vif";
				};
			};
		};

		xc {

			resume {

				stage0 {
					post-condition = "xc";
					pre-condition = "vdec", "avd", "miu", "mvop", "pnl";
				};
			};

			suspend {

				stage0 {
					post-condition = "xc";
					pre-condition = "pq", "ace";
				};
			};
		};
	};

	PAS_PTS_INTRL_COMBINE {
		compatible = "PAS_PTS_INTRL_COMBINE";
		interrupts = <0x0 0xa7 0x4>;
	};

	SE_DSP2UP_intr {
		compatible = "SE_DSP2UP_intr";
		interrupts = <0x0 0x4e 0x4>;
	};

	SPDIF_IN_NON_PCM_INT_OUT {
		compatible = "SPDIF_IN_NON_PCM_INT_OUT";
		interrupts = <0x0 0x4c 0x4>;
	};

	__symbols__ {
		EMAC_MEM = "/mmap_info/EMAC_MEM";
		E_MMAP_ID_ARMFW_MEM = "/mmap_info/E_MMAP_ID_ARMFW_MEM";
		E_MMAP_ID_HW_AES_BUF = "/mmap_info/E_MMAP_ID_HW_AES_BUF";
		E_MMAP_ID_IOMMU_MPU_TABLE = "/mmap_info/E_MMAP_ID_IOMMU_MPU_TABLE";
		E_MMAP_ID_OPTEE_MEM = "/mmap_info/E_MMAP_ID_OPTEE_MEM";
		E_MMAP_ID_OPTEE_MEM_SHM = "/mmap_info/E_MMAP_ID_OPTEE_MEM_SHM";
		MEMC_VGSYNC_DATA_BUFFER = "/mmap_info/MEMC_VGSYNC_DATA_BUFFER";
		MI_ABF_BUF = "/mmap_info/MI_ABF_BUF";
		MI_ADL_B2R = "/mmap_info/MI_ADL_B2R";
		MI_AISR_STATISTIC_BUF = "/mmap_info/MI_AISR_STATISTIC_BUF";
		MI_AN_RECOVERY_BUF = "/mmap_info/MI_AN_RECOVERY_BUF";
		MI_AUCOMM_MEM = "/mmap_info/MI_AUCOMM_MEM";
		MI_AUDIO_CPU_1 = "/mmap_info/MI_AUDIO_CPU_1";
		MI_AUDIO_CPU_2 = "/mmap_info/MI_AUDIO_CPU_2";
		MI_BOOTLOGO_BUF = "/mmap_info/MI_BOOTLOGO_BUF";
		MI_CM4_VOICE = "/mmap_info/MI_CM4_VOICE";
		MI_CMDQ_BUF = "/mmap_info/MI_CMDQ_BUF";
		MI_CONTROLMAP_BUF = "/mmap_info/MI_CONTROLMAP_BUF";
		MI_DISPOUT_DEMURA = "/mmap_info/MI_DISPOUT_DEMURA";
		MI_DISPOUT_LOCAL_DIMMING = "/mmap_info/MI_DISPOUT_LOCAL_DIMMING";
		MI_DISP_AUTO_DOWNLOAD = "/mmap_info/MI_DISP_AUTO_DOWNLOAD";
		MI_DISP_AUTO_UPLOAD = "/mmap_info/MI_DISP_AUTO_UPLOAD";
		MI_DISP_CONFIG_MEMORY = "/mmap_info/MI_DISP_CONFIG_MEMORY";
		MI_DISP_CUS_SWREG_MEMORY = "/mmap_info/MI_DISP_CUS_SWREG_MEMORY";
		MI_DISP_GUCD_DMA = "/mmap_info/MI_DISP_GUCD_DMA";
		MI_DISP_LOCALCOLOR_DMA = "/mmap_info/MI_DISP_LOCALCOLOR_DMA";
		MI_DISP_PHOTO_BUF = "/mmap_info/MI_DISP_PHOTO_BUF";
		MI_DISP_PQ_DF_MEMORY_LAYER = "/mmap_info/MI_DISP_PQ_DF_MEMORY_LAYER";
		MI_DISP_PQ_MEMORY = "/mmap_info/MI_DISP_PQ_MEMORY";
		MI_DISP_SRS_MEMORY = "/mmap_info/MI_DISP_SRS_MEMORY";
		MI_DMD_DVBT = "/mmap_info/MI_DMD_DVBT";
		MI_DRAMC_HW_TRACKING = "/mmap_info/MI_DRAMC_HW_TRACKING";
		MI_DV_DMA_BUF = "/mmap_info/MI_DV_DMA_BUF";
		MI_DV_PYR_BUF = "/mmap_info/MI_DV_PYR_BUF";
		MI_EFUSE = "/mmap_info/MI_EFUSE";
		MI_EXTIN_VD_COMB_BUF = "/mmap_info/MI_EXTIN_VD_COMB_BUF";
		MI_FRC_FW_MEM = "/mmap_info/MI_FRC_FW_MEM";
		MI_FRC_SHM = "/mmap_info/MI_FRC_SHM";
		MI_GE_VQCMD_BUF = "/mmap_info/MI_GE_VQCMD_BUF";
		MI_GOP_REGDMA_BASE = "/mmap_info/MI_GOP_REGDMA_BASE";
		MI_GOP_RPMSG = "/mmap_info/MI_GOP_RPMSG";
		MI_HDMIRX_MEM_SHM = "/mmap_info/MI_HDMIRX_MEM_SHM";
		MI_HWI2C_MEM = "/mmap_info/MI_HWI2C_MEM";
		MI_JPD_INTER_BUF = "/mmap_info/MI_JPD_INTER_BUF";
		MI_JPD_OUT = "/mmap_info/MI_JPD_OUT";
		MI_JPD_READ_BUF = "/mmap_info/MI_JPD_READ_BUF";
		MI_KERNEL1_RANGE0 = "/mmap_info/MI_KERNEL1_RANGE0";
		MI_KERNEL1_RANGE1 = "/mmap_info/MI_KERNEL1_RANGE1";
		MI_KERNEL1_RANGE2 = "/mmap_info/MI_KERNEL1_RANGE2";
		MI_KERNEL_POOL1 = "/mmap_info/MI_KERNEL_POOL1";
		MI_KERNEL_POOL2 = "/mmap_info/MI_KERNEL_POOL2";
		MI_MAD_ADV_BUF = "/mmap_info/MI_MAD_ADV_BUF";
		MI_MAD_DEC_BUF = "/mmap_info/MI_MAD_DEC_BUF";
		MI_MAD_SE_BUF = "/mmap_info/MI_MAD_SE_BUF";
		MI_MBOOT_MEM_USAGE = "/mmap_info/MI_MBOOT_MEM_USAGE";
		MI_MCDI_BUF = "/mmap_info/MI_MCDI_BUF";
		MI_MCU_DS = "/mmap_info/MI_MCU_DS";
		MI_MEMC_MV_BUFFER = "/mmap_info/MI_MEMC_MV_BUFFER";
		MI_MEMC_REALDATA = "/mmap_info/MI_MEMC_REALDATA";
		MI_MENULOAD_BUF = "/mmap_info/MI_MENULOAD_BUF";
		MI_METADATA_BUF = "/mmap_info/MI_METADATA_BUF";
		MI_MMAP_CFD_BUF = "/mmap_info/MI_MMAP_CFD_BUF";
		MI_ONLY_STR_BUF = "/mmap_info/MI_ONLY_STR_BUF";
		MI_PMU_MSPI_MEM = "/mmap_info/MI_PMU_MSPI_MEM";
		MI_PMU_RPMSG_RSCTABLE = "/mmap_info/MI_PMU_RPMSG_RSCTABLE";
		MI_PMU_RPMSG_VDEV = "/mmap_info/MI_PMU_RPMSG_VDEV";
		MI_PMU_RPMSG_VRING0 = "/mmap_info/MI_PMU_RPMSG_VRING0";
		MI_PMU_RPMSG_VRING1 = "/mmap_info/MI_PMU_RPMSG_VRING1";
		MI_PQMAP_BUF = "/mmap_info/MI_PQMAP_BUF";
		MI_PQPARAM_METADATA = "/mmap_info/MI_PQPARAM_METADATA";
		MI_PQU_DOLBY_CONFIG_MEM = "/mmap_info/MI_PQU_DOLBY_CONFIG_MEM";
		MI_PQU_FW_MEM = "/mmap_info/MI_PQU_FW_MEM";
		MI_PQU_RPMSG_VDEV = "/mmap_info/MI_PQU_RPMSG_VDEV";
		MI_PQU_RPMSG_VRING0 = "/mmap_info/MI_PQU_RPMSG_VRING0";
		MI_PQU_RPMSG_VRING1 = "/mmap_info/MI_PQU_RPMSG_VRING1";
		MI_PQU_SHM = "/mmap_info/MI_PQU_SHM";
		MI_PQU_SHMCTRL = "/mmap_info/MI_PQU_SHMCTRL";
		MI_RENDER_METADATA = "/mmap_info/MI_RENDER_METADATA";
		MI_SRCCAP_SWREG_BUF = "/mmap_info/MI_SRCCAP_SWREG_BUF";
		MI_STREAMON_METADATA = "/mmap_info/MI_STREAMON_METADATA";
		MI_STR_LDR_BUF = "/mmap_info/MI_STR_LDR_BUF";
		MI_TEE_LOADER = "/mmap_info/MI_TEE_LOADER";
		MI_TSO_FILEIN_BUF = "/mmap_info/MI_TSO_FILEIN_BUF";
		MI_TSP_FW_BUF = "/mmap_info/MI_TSP_FW_BUF";
		MI_TSP_SECT_BUF = "/mmap_info/MI_TSP_SECT_BUF";
		MI_TSP_SVQ_BUF = "/mmap_info/MI_TSP_SVQ_BUF";
		MI_TSP_VQ_BUF = "/mmap_info/MI_TSP_VQ_BUF";
		MI_VBI_BUF = "/mmap_info/MI_VBI_BUF";
		MI_VDEC_CC_RAW_DATA = "/mmap_info/MI_VDEC_CC_RAW_DATA";
		MI_VDEC_FRAME_BUF = "/mmap_info/MI_VDEC_FRAME_BUF";
		MI_VDEC_SHARE_MEM = "/mmap_info/MI_VDEC_SHARE_MEM";
		MI_VE_FRAME_BUF = "/mmap_info/MI_VE_FRAME_BUF";
		MI_VOC_OWL = "/mmap_info/MI_VOC_OWL";
		MI_ZNR_BUF = "/mmap_info/MI_ZNR_BUF";
		UCD_SHM_BUFFER = "/mmap_info/UCD_SHM_BUFFER";
		backlight = "/backlight";
		cluster0 = "/cpus/cpu-map/cluster0";
		cma_22 = "/reserved-memory/cma_22";
		cma_23 = "/reserved-memory/cma_23";
		cpu0 = "/cpus/cpu@0";
		cpu1 = "/cpus/cpu@1";
		cpu2 = "/cpus/cpu@2";
		cpu3 = "/cpus/cpu@3";
		cpu_opp_table = "/opp-table";
		default_cma_range = "/reserved-memory/default_cma";
		extcon_gpio = "/extcon-headset";
		firmware = "/firmware";
		gpio = "/gpio";
		gpio_wifi_ctl = "/gpio_wifi_ctl";
		i2c0 = "/i2c@0";
		i2c1 = "/i2c@1";
		iommu = "/iommu";
		iommu_carveout = "/reserved-memory/iommu_carveout@cv0";
		iommu_carveout0 = "/iommu_carveout0";
		iommu_cma1 = "/reserved-memory/iommu_cma1@cm1";
		iommu_cma2 = "/reserved-memory/iommu_cma2@cm2";
		iommu_cmaheap1 = "/iommu_cmaheap1";
		iommu_dmaheap = "/iommu_dmaheap";
		iommu_test = "/iommu_test";
		ion_iommu = "/ion";
		keypad = "/keypad";
		mem_cust_policy = "/mem_cust_policy";
		memory_info = "/memory_info";
		mtk_demod = "/mtk-demod";
		mtk_disp_photo = "/mtk-disp-photo";
		mtk_edmc = "/edmc@1078c000";
		mtk_mdla = "/mdla";
		mtk_mmap = "/mmap_info";
		mtk_sensor0 = "/mtk-sensor@0";
		mtk_thermal = "/thermal-zones/mtk-thermal";
		mtk_tsp_sect = "/mtk-tsp-sect";
		mtk_vd = "/mtk-vd";
		mtktv_regulator = "/mtktv-regulator";
		overtemp_point = "/thermal-zones/mtk-thermal/trips/trip-point@1";
		reserved_memory = "/reserved-memory";
		reset_point = "/thermal-zones/mtk-thermal/trips/trip-point@2";
		switch_gpio = "/switch_gpio";
	};

	acpu_int {
		compatible = "acpu_int";
		interrupts = <0x0 0x3c 0x4>;
	};

	adcdvi2riu_int {
		compatible = "adcdvi2riu_int";
		interrupts = <0x0 0xf 0x4>;
	};

	adcpll_int {
		compatible = "adcpll_int";
		interrupts = <0x0 0xbc 0x4>;
	};

	aesdma_s_int {
		compatible = "aesdma_s_int";
		interrupts = <0x0 0xc0 0x4>;
	};

	alsa {
		compatible = "Mstar-alsa";
	};

	backlight {
		bl_ctrl = <0xb>;
		bl_ctrl_inverse = <0x0>;
		brightness-levels = <0x0 0xff>;
		compatible = "backlight";
		default-brightness-level = <0xff>;
		led_gpio = <0x6>;
		led_gpio_invert = <0x0>;
		phandle = <0x85>;
		vcc_gpio = <0x9>;
		vcc_gpio_invert = <0x0>;
	};

	buf_tag {

		cap_more {
			cache = <0x2>;
			heaptype = <0x0>;
			id = <0x53>;
			max_size = <0x0 0xc00000>;
			miu = <0x0>;
			normal_zone = <0x0>;
		};

		cap_once {
			cache = <0x2>;
			heaptype = <0x0>;
			id = <0x51>;
			max_size = <0x0 0x800000>;
			miu = <0x0>;
			normal_zone = <0x0>;
		};

		cap_once_ge {
			cache = <0x2>;
			heaptype = <0x0>;
			id = <0x52>;
			max_size = <0x0 0x800000>;
			miu = <0x0>;
			normal_zone = <0x0>;
		};

		directfb_frame0 {
			cache = <0x2>;
			heaptype = <0x0>;
			id = <0xe>;
			max_size = <0x0 0x8000000>;
			miu = <0x0>;
			normal_zone = <0x0>;
		};

		directfb_frame1 {
			cache = <0x2>;
			heaptype = <0x0>;
			id = <0xf>;
			max_size = <0x0 0x1200000>;
			miu = <0x0>;
			normal_zone = <0x0>;
		};

		disp_photo {
			cache = <0x2>;
			heaptype = <0x0>;
			id = <0xd>;
			max_size = <0x0 0x4000000>;
			miu = <0x0>;
			normal_zone = <0x0>;
		};

		factory_osd {
			cache = <0x2>;
			heaptype = <0x0>;
			id = <0x55>;
			max_size = <0x0 0x800000>;
			miu = <0x0>;
			normal_zone = <0x0>;
		};

		fbdev {
			cache = <0x2>;
			heaptype = <0x0>;
			id = <0x56>;
			max_size = <0x0 0x4000000>;
			miu = <0x0>;
			normal_zone = <0x0>;
		};

		img_frame {
			cache = <0x2>;
			heaptype = <0x0>;
			id = <0x9>;
			max_size = <0x0 0x2000000>;
			miu = <0x0>;
			normal_zone = <0x0>;
		};

		inject_filein {
			cache = <0x2>;
			heaptype = <0x0>;
			id = <0x57>;
			max_size = <0x0 0x200000>;
			miu = <0x0>;
			mmap_name = "MI_INJECT_BUF";
			normal_zone = <0x0>;
		};

		inject_secure {
			cache = <0x2>;
			heaptype = <0x0>;
			id = <0x58>;
			max_size = <0x0 0x200000>;
			miu = <0x0>;
			mmap_name = "E_MMAP_ID_OPTEE_MEM_EXT";
			normal_zone = <0x0>;
		};

		jpd_inter {
			cache = <0x2>;
			heaptype = <0x0>;
			id = <0xc>;
			max_size = <0x0 0xd00000>;
			miu = <0x0>;
			normal_zone = <0x0>;
		};

		jpd_read {
			cache = <0x2>;
			heaptype = <0x0>;
			id = <0xb>;
			max_size = <0x0 0x500000>;
			miu = <0x0>;
			normal_zone = <0x0>;
		};

		jpd_write {
			cache = <0x2>;
			heaptype = <0x0>;
			id = <0xa>;
			max_size = <0x0 0x2000000>;
			miu = <0x0>;
			normal_zone = <0x0>;
		};

		mali_gop {
			cache = <0x2>;
			heaptype = <0x0>;
			id = <0x6>;
			max_size = <0x0 0x19000000>;
			miu = <0x0>;
			normal_zone = <0x1>;
		};

		mali_gop_dma {
			cache = <0x2>;
			heaptype = <0x0>;
			id = <0x5>;
			max_size = <0x0 0x6000000>;
			miu = <0x0>;
			normal_zone = <0x0>;
		};

		mdla_buf {
			cache = <0x2>;
			heaptype = <0x0>;
			id = <0x28>;
			max_size = <0x0 0xec00000>;
			miu = <0x0>;
			normal_zone = <0x0>;
		};

		mheg_inter {
			cache = <0x2>;
			heaptype = <0x0>;
			id = <0x4c>;
			max_size = <0x0 0xd00000>;
			miu = <0x0>;
			normal_zone = <0x0>;
		};

		mheg_read {
			cache = <0x2>;
			heaptype = <0x0>;
			id = <0x4a>;
			max_size = <0x0 0x500000>;
			miu = <0x0>;
			normal_zone = <0x0>;
		};

		mheg_write {
			cache = <0x2>;
			heaptype = <0x0>;
			id = <0x4b>;
			max_size = <0x0 0x2000000>;
			miu = <0x0>;
			normal_zone = <0x0>;
		};

		mmutils_cap {
			cache = <0x2>;
			heaptype = <0x0>;
			id = <0x50>;
			max_size = <0x0 0xc00000>;
			miu = <0x0>;
			normal_zone = <0x0>;
		};

		tsp_alppvr {
			cache = <0x2>;
			heaptype = <0x0>;
			id = <0x13>;
			max_size = <0x0 0xc00000>;
			miu = <0x0>;
			normal_zone = <0x0>;
		};

		tsp_filein {
			cache = <0x2>;
			heaptype = <0x0>;
			id = <0x11>;
			max_size = <0x0 0x240000>;
			miu = <0x0>;
			normal_zone = <0x0>;
		};

		tsp_fiq {
			cache = <0x2>;
			heaptype = <0x0>;
			id = <0x12>;
			max_size = <0x0 0x402000>;
			miu = <0x0>;
			normal_zone = <0x0>;
		};

		tsp_pvr {
			cache = <0x2>;
			heaptype = <0x0>;
			id = <0x10>;
			max_size = <0x0 0xd80000>;
			miu = <0x0>;
			normal_zone = <0x0>;
		};

		tsr_ginga {
			cache = <0x2>;
			heaptype = <0x0>;
			id = <0x4e>;
			max_size = <0x0 0x800000>;
			miu = <0x0>;
			normal_zone = <0x0>;
		};

		vdec_es {
			cache = <0x2>;
			heaptype = <0x0>;
			id = <0x2>;
			max_size = <0x0 0x1400000>;
			miu = <0x0>;
			normal_zone = <0x0>;
		};

		vdec_fb {
			cache = <0x2>;
			heaptype = <0x2>;
			id = <0x1>;
			max_size = <0x0 0x14300000>;
			miu = <0x0>;
			normal_zone = <0x0>;
		};

		xc_frc_l {
			cache = <0x2>;
			heaptype = <0x0>;
			id = <0x8>;
			max_size = <0x0 0x8200000>;
			miu = <0x0>;
			normal_zone = <0x0>;
		};

		xc_frc_pq {
			cache = <0x2>;
			heaptype = <0x0>;
			id = <0x7>;
			max_size = <0x0 0xf00000>;
			miu = <0x0>;
			normal_zone = <0x0>;
		};

		xc_hse {
			cache = <0x2>;
			heaptype = <0x0>;
			id = <0x4>;
			max_size = <0x0 0x1000000>;
			miu = <0x0>;
			normal_zone = <0x0>;
		};

		xc_main {
			cache = <0x2>;
			heaptype = <0x0>;
			id = <0x3>;
			max_size = <0x0 0x1400000>;
			miu = <0x0>;
			normal_zone = <0x0>;
		};

		xc_sub {
			cache = <0x2>;
			heaptype = <0x0>;
			id = <0x4a>;
			max_size = <0x0 0x1800000>;
			miu = <0x0>;
			normal_zone = <0x0>;
		};
	};

	cec_int_pm {
		compatible = "cec_int_pm";
		interrupts = <0x0 0x36 0x4>;
	};

	chosen {
		bootargs = "root=/dev/mmcblk0p4 rootfstype=ext4 rw rootwait init=/sbin/init ip=dhcp console=ttyS0,115200,LX_MEM=0x02000000";
	};

	codec_auto_bist_int {
		compatible = "codec_auto_bist_int";
		interrupts = <0x0 0xaf 0x4>;
	};

	comb_int {
		compatible = "comb_int";
		interrupts = <0x0 0xe 0x4>;
	};

	cpus {
		#address-cells = <0x1>;
		#size-cells = <0x0>;

		cpu-map {

			cluster0 {
				phandle = <0x13>;

				core0 {
					cpu = <0x2>;
				};

				core1 {
					cpu = <0x3>;
				};

				core2 {
					cpu = <0x4>;
				};

				core3 {
					cpu = <0x5>;
				};
			};
		};

		cpu@0 {
			#cooling-cells = <0x2>;
			compatible = "arm,armv8";
			cpu-release-addr = <0x100510>;
			device_type = "cpu";
			enable-method = "psci";
			operating-points-v2 = <0x6>;
			phandle = <0x2>;
			reg = <0x0 0x0>;
		};

		cpu@1 {
			#cooling-cells = <0x2>;
			compatible = "arm,armv8";
			cpu-release-addr = <0x100510>;
			device_type = "cpu";
			enable-method = "psci";
			operating-points-v2 = <0x6>;
			phandle = <0x3>;
			reg = <0x0 0x100>;
		};

		cpu@2 {
			#cooling-cells = <0x2>;
			compatible = "arm,armv8";
			cpu-release-addr = <0x100510>;
			device_type = "cpu";
			enable-method = "psci";
			operating-points-v2 = <0x6>;
			phandle = <0x4>;
			reg = <0x0 0x200>;
		};

		cpu@3 {
			#cooling-cells = <0x2>;
			compatible = "arm,armv8";
			cpu-release-addr = <0x100510>;
			device_type = "cpu";
			enable-method = "psci";
			operating-points-v2 = <0x6>;
			phandle = <0x5>;
			reg = <0x0 0x300>;
		};
	};

	d2b_int {
		compatible = "d2b_int";
		interrupts = <0x0 0x1a 0x4>;
	};

	dc_int {
		compatible = "dc_int";
		interrupts = <0x0 0x13 0x4>;
	};

	dcsub_int {
		compatible = "dcsub_int";
		interrupts = <0x0 0x0 0x4>;
	};

	dig_dft_bus_out_10 {
		compatible = "dig_dft_bus_out_10";
		interrupts = <0x0 0x4a 0x4>;
	};

	dig_dft_bus_out_3 {
		compatible = "dig_dft_bus_out_3";
		interrupts = <0x0 0x43 0x4>;
	};

	dig_dft_bus_out_39 {
		compatible = "dig_dft_bus_out_39";
		interrupts = <0x0 0x67 0x4>;
	};

	dig_dft_bus_out_43 {
		compatible = "dig_dft_bus_out_43";
		interrupts = <0x0 0x6b 0x4>;
	};

	dip_int {
		compatible = "dip_int";
		interrupts = <0x0 0xab 0x4>;
	};

	disp_int {
		compatible = "disp_int";
		interrupts = <0x0 0xa 0x4>;
	};

	dmdmcu2hk_int {
		compatible = "dmdmcu2hk_int";
		interrupts = <0x0 0x54 0x4>;
	};

	dmic {
		compatible = "Mstar-dmic";
	};

	dvi_hdmi_hdcp_int {
		compatible = "dvi_hdmi_hdcp_int";
		interrupts = <0x0 0x34 0x4>;
	};

	edmc@1078c000 {
		compatible = "mtk,edmc";
		interrupts = <0x0 0xbe 0x4>;
		phandle = <0x7f>;
		reg = <0x0 0x1f3ec000 0x0 0x1000>;
	};

	emac {
		compatible = "mstar-emac";
	};

	emac_int {
		compatible = "emac_int";
		interrupts = <0x0 0x9 0x4>;
	};

	emac_man_int {
		compatible = "emac_man_int";
		interrupts = <0x0 0x6f 0x4>;
	};

	error_resp_int {
		compatible = "error_resp_int";
		interrupts = <0x0 0x18 0x4>;
	};

	evd_int {
		compatible = "evd_int";
		interrupts = <0x0 0xd 0x4>;
	};

	ext_gpio_merge_int {
		compatible = "ext_gpio_merge_int";
		interrupts = <0x0 0x3f 0x4>;
	};

	extcon-headset {
		compatible = "mediatek,extcon-headset";
		extcon-gpios = <0x25 0x0>;
		extcon-id = <0x15>;
		gpio-line-names = "extcon";
		phandle = <0x7d>;
	};

	firmware {
		phandle = <0x80>;

		android {
			Processor = "AArch32 Processor rev 3 (aarch32)";
			Serial = "0000000000000000";
			baseband = "20170621";
			compatible = "android,firmware";
			hardware = "mt5867";
			mode = "20170621";
			revision = "0001";
		};

		optee {
			compatible = "linaro,optee-tz";
			method = "smc";
		};
	};

	g3d2mcu_irq_dft {
		compatible = "g3d2mcu_irq_dft";
		interrupts = <0x0 0x12 0x4>;
	};

	ge_int {
		compatible = "ge_int";
		interrupts = <0x0 0x2c 0x4>;
	};

	gflip {
		compatible = "mstar-gflip";
	};

	gop_int {
		compatible = "gop_int";
		interrupts = <0x0 0x14 0x4>;
	};

	gpio {
		#gpio-cells = <0x1>;
		#interrupt-cells = <0x2>;
		compatible = "mstar,gpio";
		gpio-controller;
		interrupt-controller;
		phandle = <0x81>;
		skip-save-status = <0xb 0x9 0x6>;
	};

	gpio_wifi_ctl {
		compatible = "mstar,gpio-wifi-ctl";
		phandle = <0x83>;
		wifi-ctl-gpio = <0x1c>;
	};

	hdcp_iic_int {
		compatible = "hdcp_iic_int";
		interrupts = <0x0 0x37 0x4>;
	};

	hdcp_x74_int {
		compatible = "hdcp_x74_int";
		interrupts = <0x0 0x38 0x4>;
	};

	hi_codec_auto_bist_int {
		compatible = "hi_codec_auto_bist_int";
		interrupts = <0x0 0xb0 0x4>;
	};

	hvd_int {
		compatible = "hvd_int";
		interrupts = <0x0 0xc 0x4>;
	};

	i2c@0 {
		bus-index = <0x0>;
		compatible = "mstar,swi2c";
		def-delay = <0x64>;
		hw-port = <0x3>;
		iic-mode = <0x1>;
		pad-mux = <0x19>;
		phandle = <0x86>;
		retries = <0x5>;
		scl-gpio = <0x36>;
		sda-gpio = <0x37>;
		speed-khz = <0x64>;
		status = "okay";
	};

	i2c@1 {
		bus-index = <0x1>;
		compatible = "mstar,swi2c";
		def-delay = <0x64>;
		hw-port = <0x0>;
		iic-mode = <0x0>;
		pad-mux = <0x0>;
		phandle = <0x87>;
		retries = <0x5>;
		scl-gpio = <0x23>;
		sda-gpio = <0x24>;
		speed-khz = <0x64>;
		status = "okay";
	};

	imi_top_irq {
		compatible = "imi_top_irq";
		interrupts = <0x0 0xa8 0x4>;
	};

	int_bdma_0 {
		compatible = "int_bdma_0";
		interrupts = <0x0 0x30 0x4>;
	};

	int_bdma_1 {
		compatible = "int_bdma_1";
		interrupts = <0x0 0x31 0x4>;
	};

	int_in {
		compatible = "int_in";
		interrupts = <0x0 0x5a 0x4>;
	};

	int_timer0 {
		compatible = "int_timer0";
		interrupts = <0x0 0x40 0x4>;
	};

	int_timer1 {
		compatible = "int_timer1";
		interrupts = <0x0 0x41 0x4>;
	};

	int_timer2 {
		compatible = "int_timer2";
		interrupts = <0x0 0x63 0x4>;
	};

	int_uart0 {
		compatible = "int_uart0";
		interrupts = <0x0 0x26 0x4>;
	};

	int_uart1 {
		compatible = "int_uart1";
		interrupts = <0x0 0x27 0x4>;
	};

	int_wdt {
		compatible = "int_wdt";
		interrupts = <0x0 0x42 0x4>;
	};

	interrupt-controller@16001000 {
		#address-cells = <0x0>;
		#interrupt-cells = <0x3>;
		compatible = "arm,cortex-a15-gic", "arm,cortex-a9-gic";
		interrupt-controller;
		interrupts = <0x1 0x9 0xf04>;
		linux,phandle = <0x1>;
		phandle = <0x1>;
		reg = <0x0 0x16001000 0x0 0x1000 0x0 0x16002000 0x0 0x4000>;
	};

	iommu {
		#iommu-cells = <0x1>;
		compatible = "mediatek,dtv-iommu";
		interrupts = <0x0 0x2d 0x4>;
		phandle = <0x7>;
		reg = <0x0 0x1c240400 0x0 0x200>;
		reg-names = "seal";
		status = "okay";
	};

	iommu_carveout0 {
		compatible = "mediatek,dtv-iommu-carveout";
		memory-region = <0x8>;
		phandle = <0x1a>;
		status = "okay";
	};

	iommu_cmaheap1 {
		compatible = "mediatek,dtv-iommu-cma1";
		memory-region = <0x9>;
		phandle = <0x1b>;
		status = "okay";
	};

	iommu_dmaheap {
		compatible = "mediatek,dtv-iommu-dmaheap";
		iommus = <0x7 0x0>;
		phandle = <0x19>;
		status = "okay";
	};

	iommu_test {
		compatible = "mediatek,dtv-iommu-test";
		iommus = <0x7 0x0>;
		phandle = <0x17>;
		status = "okay";
	};

	ion {
		compatible = "mediatek,dtv-iommu-ion";
		iommus = <0x7 0x0>;
		phandle = <0x18>;
		status = "okay";
	};

	ir {
		compatible = "mstar-ir";
	};

	ir_in {
		compatible = "ir_in";
		interrupts = <0x0 0x62 0x4>;
	};

	ir_int {
		compatible = "ir_int";
		interrupts = <0x0 0x5b 0x4>;
	};

	ir_int_rc {
		compatible = "ir_int_rc";
		interrupts = <0x0 0x60 0x4>;
	};

	irq_aeon2hi {
		compatible = "irq_aeon2hi";
		interrupts = <0x0 0x2 0x4>;
	};

	irq_vd_evd_r22hi {
		compatible = "irq_vd_evd_r22hi";
		interrupts = <0x0 0xa6 0x4>;
	};

	jpd_gpd_merge_int {
		compatible = "jpd_gpd_merge_int";
		interrupts = <0x0 0x3e 0x4>;
	};

	keypad {
		compatible = "mtk,hq-keypad";
		interrupts = <0x0 0x1 0x4>;
		linux,input-no-autorepeat;
		mtk,keypad-chanel = <0x0>;
		mtk,keypad-lowbd = <0x350>;
		mtk,keypad-num = <0x8>;
		mtk,keypad-upwbd = <0x3ff>;
		phandle = <0x84>;
		reg = <0x0 0x1f002800 0x0 0x200>;
		wakeup-source;

		key_1 {
			keypad,threshold = <0x339>;
			linux,code = <0x8b>;
		};

		key_2 {
			keypad,threshold = <0x2db>;
			linux,code = <0x4f>;
		};

		key_3 {
			keypad,threshold = <0x275>;
			linux,code = <0x1c>;
		};

		key_4 {
			keypad,threshold = <0x210>;
			linux,code = <0x72>;
		};

		key_5 {
			keypad,threshold = <0x175>;
			linux,code = <0x73>;
		};

		key_6 {
			keypad,threshold = <0xf9>;
			linux,code = <0x193>;
		};

		key_7 {
			keypad,threshold = <0x81>;
			linux,code = <0x192>;
		};

		key_8 {
			keypad,threshold = <0x0>;
			linux,code = <0x74>;
		};
	};

	lan_esd_int {
		compatible = "lan_esd_int";
		interrupts = <0x0 0x4d 0x4>;
	};

	lpll_int {
		compatible = "lpll_int";
		interrupts = <0x0 0xbb 0x4>;
	};

	lzma_int {
		compatible = "lzma_int";
		interrupts = <0x0 0xb8 0x4>;
	};

	mbx {
		compatible = "mstar-mbx";
	};

	mdla {
		compatible = "mtk,mdla";
		interrupts = <0x0 0xbc 0x4>;
		phandle = <0x7e>;
		reg = <0x0 0x1f3e8000 0x0 0x1000 0x0 0x1f3e9000 0x0 0x1000 0x0 0x1f3ea000 0x0 0x1000 0x0 0x1fe00000 0x0 0x80000>;
	};

	mem_cust_policy {
		cma_region_maxsize = <0x0 0x0>;
		mali_reduce_migration = <0x1>;
		mali_threshold = <0x18000000>;
		need_2xiova = <0x2 0x39>;
		need_zeropage = <0x5 0x6>;
		phandle = <0x1c>;
	};

	memory_info {
		cpu_emi0_base = <0x20000000>;
		emi0_base_addr = <0x0>;
		phandle = <0x14>;
	};

	mheg5_auto_bist_int {
		compatible = "mheg5_auto_bist_int";
		interrupts = <0x0 0xad 0x4>;
	};

	mhl_cbus_pm_int {
		compatible = "mhl_cbus_pm_int";
		interrupts = <0x0 0x35 0x4>;
	};

	miic_0_A_int {
		compatible = "miic_0_A_int";
		interrupts = <0x0 0x3a 0x4>;
	};

	miic_1_A_int {
		compatible = "miic_1_A_int";
		interrupts = <0x0 0x3b 0x4>;
	};

	miic_2_A_int {
		compatible = "miic_2_A_int";
		interrupts = <0x0 0xbd 0x4>;
	};

	miic_3_A_int {
		compatible = "miic_3_A_int";
		interrupts = <0x0 0x3d 0x4>;
	};

	mipi_dsi_int {
		compatible = "mipi_dsi_int";
		interrupts = <0x0 0xb7 0x4>;
	};

	miu {
		compatible = "mstar-miu";
	};

	miu_esd_int {
		compatible = "miu_esd_int";
		interrupts = <0x0 0x2e 0x4>;
	};

	miu_int {
		compatible = "miu_int";
		interrupts = <0x0 0x25 0x4>;
	};

	miu_security_int {
		compatible = "miu_security_int";
		interrupts = <0x0 0x2d 0x4>;
	};

	mmap_info {
		#address-cells = <0x2>;
		#size-cells = <0x2>;
		phandle = <0x21>;
		ranges;

		EMAC_MEM {
			phandle = <0x32>;
		};

		E_MMAP_ID_ARMFW_MEM {
			phandle = <0x78>;
		};

		E_MMAP_ID_HW_AES_BUF {
			phandle = <0x7a>;
		};

		E_MMAP_ID_IOMMU_MPU_TABLE {
			phandle = <0x67>;
		};

		E_MMAP_ID_OPTEE_MEM {
			phandle = <0x79>;
		};

		E_MMAP_ID_OPTEE_MEM_SHM {
			phandle = <0x7b>;
		};

		MEMC_VGSYNC_DATA_BUFFER {
			phandle = <0x64>;
		};

		MI_ABF_BUF {
			phandle = <0x54>;
		};

		MI_ADL_B2R {
			phandle = <0x27>;
		};

		MI_AISR_STATISTIC_BUF {
			phandle = <0x74>;
		};

		MI_AN_RECOVERY_BUF {
			phandle = <0x76>;
		};

		MI_AUCOMM_MEM {
			phandle = <0x35>;
		};

		MI_AUDIO_CPU_1 {
			phandle = <0x38>;
		};

		MI_AUDIO_CPU_2 {
			phandle = <0x39>;
		};

		MI_BOOTLOGO_BUF {
			phandle = <0x63>;
		};

		MI_CM4_VOICE {
			phandle = <0x60>;
		};

		MI_CMDQ_BUF {
			phandle = <0x56>;
		};

		MI_CONTROLMAP_BUF {
			phandle = <0x5c>;
		};

		MI_DISPOUT_DEMURA {
			phandle = <0x5f>;
		};

		MI_DISPOUT_LOCAL_DIMMING {
			phandle = <0x62>;
		};

		MI_DISP_AUTO_DOWNLOAD {
			phandle = <0x49>;
		};

		MI_DISP_AUTO_UPLOAD {
			phandle = <0x53>;
		};

		MI_DISP_CONFIG_MEMORY {
			phandle = <0x65>;
		};

		MI_DISP_CUS_SWREG_MEMORY {
			phandle = <0x7c>;
		};

		MI_DISP_GUCD_DMA {
			phandle = <0x72>;
		};

		MI_DISP_LOCALCOLOR_DMA {
			phandle = <0x73>;
		};

		MI_DISP_PHOTO_BUF {
			cma_id = <0x16>;
			is_cache = <0x0>;
			layer = <0x3>;
			miu = <0x0>;
			phandle = <0xd>;
			reg = <0x0 0x2a400000 0x0 0x1000000>;
		};

		MI_DISP_PQ_DF_MEMORY_LAYER {
			phandle = <0x50>;
		};

		MI_DISP_PQ_MEMORY {
			phandle = <0x4f>;
		};

		MI_DISP_SRS_MEMORY {
			phandle = <0x59>;
		};

		MI_DMD_DVBT {
			cma_id = <0x17>;
			is_cache = <0x0>;
			layer = <0x1>;
			miu = <0x0>;
			phandle = <0xe>;
			reg = <0x0 0x53400000 0x0 0x500000>;
		};

		MI_DRAMC_HW_TRACKING {
			phandle = <0x23>;
		};

		MI_DV_DMA_BUF {
			phandle = <0x70>;
		};

		MI_DV_PYR_BUF {
			phandle = <0x71>;
		};

		MI_EFUSE {
			phandle = <0x22>;
		};

		MI_EXTIN_VD_COMB_BUF {
			cma_id = <0x17>;
			is_cache = <0x0>;
			layer = <0x1>;
			miu = <0x0>;
			phandle = <0xf>;
			reg = <0x0 0x53900000 0x0 0x400000>;
		};

		MI_FRC_FW_MEM {
			phandle = <0x3b>;
		};

		MI_FRC_SHM {
			phandle = <0x45>;
		};

		MI_GE_VQCMD_BUF {
			phandle = <0x28>;
		};

		MI_GOP_REGDMA_BASE {
			phandle = <0x4b>;
		};

		MI_GOP_RPMSG {
			phandle = <0x5d>;
		};

		MI_HDMIRX_MEM_SHM {
			phandle = <0x68>;
		};

		MI_HWI2C_MEM {
			phandle = <0x31>;
		};

		MI_JPD_INTER_BUF {
			phandle = <0x30>;
		};

		MI_JPD_OUT {
			phandle = <0x2e>;
		};

		MI_JPD_READ_BUF {
			phandle = <0x2f>;
		};

		MI_KERNEL1_RANGE0 {
			phandle = <0x2a>;
		};

		MI_KERNEL1_RANGE1 {
			phandle = <0x2b>;
		};

		MI_KERNEL1_RANGE2 {
			phandle = <0x2c>;
		};

		MI_KERNEL_POOL1 {
			phandle = <0x29>;
		};

		MI_KERNEL_POOL2 {
			phandle = <0x77>;
		};

		MI_MAD_ADV_BUF {
			phandle = <0x34>;
		};

		MI_MAD_DEC_BUF {
			phandle = <0x37>;
		};

		MI_MAD_SE_BUF {
			phandle = <0x36>;
		};

		MI_MBOOT_MEM_USAGE {
			phandle = <0x2d>;
		};

		MI_MCDI_BUF {
			phandle = <0x52>;
		};

		MI_MCU_DS {
			phandle = <0x4c>;
		};

		MI_MEMC_MV_BUFFER {
			phandle = <0x6e>;
		};

		MI_MEMC_REALDATA {
			phandle = <0x6c>;
		};

		MI_MENULOAD_BUF {
			phandle = <0x4a>;
		};

		MI_METADATA_BUF {
			phandle = <0x5a>;
		};

		MI_MMAP_CFD_BUF {
			phandle = <0x66>;
		};

		MI_ONLY_STR_BUF {
			phandle = <0x58>;
		};

		MI_PMU_MSPI_MEM {
			phandle = <0x40>;
		};

		MI_PMU_RPMSG_RSCTABLE {
			phandle = <0x3f>;
		};

		MI_PMU_RPMSG_VDEV {
			phandle = <0x3e>;
		};

		MI_PMU_RPMSG_VRING0 {
			phandle = <0x3c>;
		};

		MI_PMU_RPMSG_VRING1 {
			phandle = <0x3d>;
		};

		MI_PQMAP_BUF {
			phandle = <0x5b>;
		};

		MI_PQPARAM_METADATA {
			phandle = <0x69>;
		};

		MI_PQU_DOLBY_CONFIG_MEM {
			phandle = <0x6f>;
		};

		MI_PQU_FW_MEM {
			phandle = <0x3a>;
		};

		MI_PQU_RPMSG_VDEV {
			phandle = <0x43>;
		};

		MI_PQU_RPMSG_VRING0 {
			phandle = <0x41>;
		};

		MI_PQU_RPMSG_VRING1 {
			phandle = <0x42>;
		};

		MI_PQU_SHM {
			phandle = <0x44>;
		};

		MI_PQU_SHMCTRL {
			phandle = <0x26>;
		};

		MI_RENDER_METADATA {
			phandle = <0x6b>;
		};

		MI_SRCCAP_SWREG_BUF {
			phandle = <0x75>;
		};

		MI_STREAMON_METADATA {
			phandle = <0x6a>;
		};

		MI_STR_LDR_BUF {
			phandle = <0x57>;
		};

		MI_TEE_LOADER {
			phandle = <0x24>;
		};

		MI_TSO_FILEIN_BUF {
			phandle = <0x48>;
		};

		MI_TSP_FW_BUF {
			phandle = <0x25>;
		};

		MI_TSP_SECT_BUF {
			cma_id = <0x17>;
			is_cache = <0x0>;
			layer = <0x1>;
			miu = <0x0>;
			phandle = <0x10>;
			reg = <0x0 0x53d00000 0x0 0x400000>;
		};

		MI_TSP_SVQ_BUF {
			phandle = <0x47>;
		};

		MI_TSP_VQ_BUF {
			phandle = <0x46>;
		};

		MI_VBI_BUF {
			phandle = <0x5e>;
		};

		MI_VDEC_CC_RAW_DATA {
			phandle = <0x4d>;
		};

		MI_VDEC_FRAME_BUF {
			phandle = <0x33>;
		};

		MI_VDEC_SHARE_MEM {
			phandle = <0x4e>;
		};

		MI_VE_FRAME_BUF {
			phandle = <0x51>;
		};

		MI_VOC_OWL {
			phandle = <0x61>;
		};

		MI_ZNR_BUF {
			phandle = <0x55>;
		};

		UCD_SHM_BUFFER {
			phandle = <0x6d>;
		};
	};

	mmc_host_sdio {
		cd-option = <0x1 0x101e 0x50 0x1>;
		compatible = "mstar, sdio";
		pc-option = <0x0 0x0 0x0 0x0>;
		sdio-fast-connect = <0x0>;
		sdio-padmux = <0x1>;
		sdio-volt-type = <0x0>;
		wp-option = <0x0 0x0 0x0 0x0>;
	};

	mod_detect_intr {
		compatible = "mod_detect_intr";
		interrupts = <0x0 0xba 0x4>;
	};

	mspi0_int {
		compatible = "mspi0_int";
		interrupts = <0x0 0x2f 0x4>;
	};

	mspi2_int {
		compatible = "mspi2_int";
		interrupts = <0x0 0xbf 0x4>;
	};

	mstar-frc-r2 {
		compatible = "FRC-R2";
	};

	mstar-rtc@0 {
		compatible = "mstar-rtc";
		freq = <0x1>;
		index = <0x0>;
		xtal = <0xb71b00>;
	};

	mtk-demod {
		cmas = <0x0>;
		compatible = "mediatek, DMD_CMA";
		memory-region = <0xc 0xe>;
		phandle = <0x1e>;
		unique_id = <0x0>;
	};

	mtk-disp-photo {
		cmas = <0x0>;
		compatible = "mediatek, disp_photo_cma";
		memory-region = <0xb 0xd>;
		phandle = <0x1d>;
		unique_id = <0x0>;
	};

	mtk-sensor@0 {
		#thermal-sensor-cells = <0x1>;
		compatible = "cpu-thermal";
		phandle = <0x11>;
	};

	mtk-tsp-sect {
		cmas = <0x0>;
		compatible = "mediatek, mtk-tsp";
		memory-region = <0xc 0x10>;
		phandle = <0x20>;
		unique_id = <0x0>;
	};

	mtk-vd {
		cmas = <0x0>;
		compatible = "mediatek, mtk-vd";
		memory-region = <0xc 0xf>;
		phandle = <0x1f>;
		unique_id = <0x0>;
	};

	mtk_mmap_device {
		cmas = <0x0>;
		compatible = "mediatek,tv-reserved-memory";
		memory-region = <0xa>;
		mtk_cma_id = <0x0>;
	};

	mtk_utopia_cma_device_1 {
		cmas = <0x0>;
		compatible = "mediatek,tv-reserved-memory";
		memory-region = <0xa>;
		mtk_cma_id = <0x0>;
	};

	mtk_utopia_cma_device_2 {
		cmas = <0x0>;
		compatible = "mediatek,tv-reserved-memory";
		memory-region = <0xb>;
		mtk_cma_id = <0x16>;
	};

	mtk_utopia_cma_device_3 {
		cmas = <0x0>;
		compatible = "mediatek,tv-reserved-memory";
		memory-region = <0xc>;
		mtk_cma_id = <0x17>;
	};

	mtktv-regulator {
		compatible = "mtktv-regulator";
		phandle = <0x88>;
		regulator-auto = <0x1>;
		regulator-channel = <0x0>;
		regulator-default = <0x100590>;
		regulator-max-microvolt = <0x13d620>;
		regulator-min-microvolt = <0xb71b0>;
		regulator-offset = <0x0>;
		regulator-scale = <0x79e>;
		regulator-type = "pwm";
	};

	mvd2mips_int {
		compatible = "mvd2mips_int";
		interrupts = <0x0 0xb 0x4>;
	};

	mvd_int {
		compatible = "mvd_int";
		interrupts = <0x0 0x3 0x4>;
	};

	nfie_int {
		compatible = "nfie_int";
		interrupts = <0x0 0x5 0x4>;
	};

	nfie_tee_int {
		compatible = "nfie_tee_int";
		interrupts = <0x0 0xaa 0x4>;
	};

	opp-table {
		boost-0 = <0x566d3e80>;
		boost-1 = <0x566d3e80>;
		boost-2 = "Yh/";
		boost-3 = <0x566d3e80>;
		boost-4 = <0x566d3e80>;
		compatible = "operating-points-v2";
		opp-shared;
		phandle = <0x6>;

		opp-1100000000 {
			opp-corner-offset = <0xc350>;
			opp-hz = <0x0 0x4190ab00>;
			opp-microvolt = <0xf4240>;
		};

		opp-1350000000 {
			opp-corner-offset = <0xc350>;
			opp-hz = <0x0 0x50775d80>;
			opp-microvolt = <0x10c8e0>;
		};

		opp-1450000000 {
			opp-corner-offset = <0xc350>;
			opp-hz = <0x0 0x566d3e80>;
			opp-microvolt = <0x118c30>;
		};

		opp-1500000000 {
			opp-corner-offset = <0xc350>;
			opp-hz = <0x0 0x59682f00>;
			opp-microvolt = <0x124f80>;
		};

		opp-750000000 {
			opp-corner-offset = <0x0>;
			opp-hz = <0x0 0x2cb41780>;
			opp-microvolt = <0xdbba0>;
		};
	};

	otg_int {
		compatible = "otg_int";
		interrupts = <0x0 0xa9 0x4>;
	};

	paga_int_level {
		compatible = "paga_int_level";
		interrupts = <0x0 0xb9 0x4>;
	};

	pcm2mcu_int {
		compatible = "pcm2mcu_int";
		interrupts = <0x0 0x15 0x4>;
	};

	pka_all_int {
		compatible = "pka_all_int";
		interrupts = <0x0 0xc1 0x4>;
	};

	pm_irq_out {
		compatible = "pm_irq_out";
		interrupts = <0x0 0xb2 0x4>;
	};

	pm_sleep_int {
		compatible = "pm_sleep_int";
		interrupts = <0x0 0x1 0x4>;
	};

	pmu {
		compatible = "arm,cortex-a15-pmu";
		interrupts = <0x0 0x86 0x4 0x0 0x88 0x4 0x0 0x8a 0x4 0x0 0x8c 0x4>;
	};

	ps_int {
		compatible = "ps_int";
		interrupts = <0x0 0x4 0x4>;
	};

	psci {
		compatible = "arm,psci";
		cpu_off = <0x84000002>;
		cpu_on = <0x84000003>;
		cpu_suspend = <0x84000001>;
		method = "smc";
	};

	pwm_fp_l_int {
		compatible = "pwm_fp_l_int";
		interrupts = <0x0 0x7c 0x4>;
	};

	pwm_fp_r_int {
		compatible = "pwm_fp_r_int";
		interrupts = <0x0 0x7e 0x4>;
	};

	pwm_rp_l_int {
		compatible = "pwm_rp_l_int";
		interrupts = <0x0 0x7b 0x4>;
	};

	pwm_rp_r_int {
		compatible = "pwm_rp_r_int";
		interrupts = <0x0 0x7d 0x4>;
	};

	qos {
		ctrl_reg_opt = <0x0 0x0 0x0 0x0>;
		dts_version = <0x1 0x0>;

		cpu {

			output-map {

				AIPQ-1 {
					id = <0x1>;
					output_set = <0x0 0x1 0x2 0x3 0x4 0x5 0x6 0x7>;
					owner = "AIPQ";
				};

				AIPQ-2 {
					id = <0x2>;
					output_set = <0x0 0x0 0x0 0x0 0x0 0x0 0x7 0x7>;
					owner = "AIPQ";
				};

				EPOLL-1 {
					id = <0x1>;
					output_set = <0x0 0x1 0x2 0x3 0x4 0x5 0x6 0x7>;
					owner = "epoll";
				};

				UCD-1 {
					id = <0x1>;
					output_set = <0x0 0x0 0x0 0x0 0x0 0x0 0x0 0x7>;
					owner = "UCD";
				};

				WRITER-1 {
					id = <0x1>;
					owner = "writer";

					write-0 {
						output_set = "2", "64", "128", "256", "512", "768", "896", "1024";
						path = "/dev/cpuctl/limit/cpu.shares";
					};

					write-1 {
						output_set = "5000", "6000", "7000", "8000", "10000", "-1", "-1", "-1";
						path = "/dev/cpuctl/limit/cpu.cfs_quota_us";
					};
				};

				WRITER-2 {
					id = <0x2>;
					owner = "writer";

					write-0 {
						output_set = "FROZEN", "FROZEN", "THAWED", "THAWED", "THAWED", "THAWED", "THAWED", "THAWED";
						path = "/dev/freezer/hate/freezer.state";
					};
				};
			};

			registry {

				keep-0 {
					comm_pid = "system_server";
					comm_tid = "InputDispatcher";
					path = "/dev/cpuctl/limit/tasks";
					pid_num = <0x1>;
					target = "TID";
					tid_num = <0x1>;
				};
			};

			scenarios {

				SD {
					delay_ctrl = <0x0 0x0 0x0 0x0>;
					init_ctrl = <0x7>;
					output_map = <0x0 0x2 0x0 0x1>;
					trigger_map = <0x5a>;

					input-events {
						video = <0x0 0x2 0x0 0x0>;
					};
				};

				SD-key {
					delay_ctrl = <0x0 0x0 0x0 0x0>;
					init_ctrl = <0x5>;
					output_map = <0x1 0x2 0x0 0x1>;
					trigger_map = <0x5a>;

					input-events {
						key_press = <0x1>;
						video = <0x0 0x2 0x0 0x0>;
						voice = <0x0>;
					};
				};

				SD-voc {
					delay_ctrl = <0x0 0x0 0x0 0x0>;
					init_ctrl = <0x5>;
					output_map = <0x0 0x2 0x0 0x1>;
					trigger_map = <0x55>;

					input-events {
						key_press = <0x0>;
						video = <0x0 0x2 0x0 0x0>;
						voice = <0x1>;
					};
				};

				SD-voc-key {
					delay_ctrl = <0x1 0x1 0x0 0x1>;
					init_ctrl = <0x3>;
					output_map = <0x1 0x2 0x0 0x1>;
					trigger_map = <0x50>;

					input-events {
						key_press = <0x1>;
						video = <0x0 0x2 0x0 0x0>;
						voice = <0x1>;
					};
				};

				default {
					output_map = <0x0 0x0 0x0 0x0>;
					trigger_map = <0x3e7>;

					input-events {
						video = <0x0 0x0 0x0 0x0>;
					};
				};

				default-key {
					output_map = <0x1 0x0 0x0 0x1>;
					trigger_map = <0x5a>;

					input-events {
						key_press = <0x1>;
						video = <0x0 0x0 0x0 0x0>;
					};
				};

				default-voc {
					output_map = <0x0 0x0 0x0 0x0>;
					trigger_map = <0x3e7>;

					input-events {
						video = <0x0 0x0 0x0 0x0>;
						voice = <0x1>;
					};
				};

				default-voc-key {
					output_map = <0x1 0x0 0x0 0x1>;
					trigger_map = <0x5a>;

					input-events {
						key_press = <0x1>;
						video = <0x0 0x0 0x0 0x0>;
						voice = <0x1>;
					};
				};
			};
		};
	};

	reg_hst0to1_int {
		compatible = "reg_hst0to1_int";
		interrupts = <0x0 0x66 0x4>;
	};

	reg_hst0to2_int {
		compatible = "reg_hst0to2_int";
		interrupts = <0x0 0x65 0x4>;
	};

	reg_hst0to3_int {
		compatible = "reg_hst0to3_int";
		interrupts = <0x0 0x64 0x4>;
	};

	reg_hst1to0_int {
		compatible = "reg_hst1to0_int";
		interrupts = <0x0 0x6a 0x4>;
	};

	reg_hst1to2_int {
		compatible = "reg_hst1to2_int";
		interrupts = <0x0 0x69 0x4>;
	};

	reg_hst1to3_int {
		compatible = "reg_hst1to3_int";
		interrupts = <0x0 0x68 0x4>;
	};

	reg_hst2to0_int {
		compatible = "reg_hst2to0_int";
		interrupts = <0x0 0x6e 0x4>;
	};

	reg_hst2to1_int {
		compatible = "reg_hst2to1_int";
		interrupts = <0x0 0x6d 0x4>;
	};

	reg_hst2to3_int {
		compatible = "reg_hst2to3_int";
		interrupts = <0x0 0x6c 0x4>;
	};

	reg_hst3to0_int {
		compatible = "reg_hst3to0_int";
		interrupts = <0x0 0x72 0x4>;
	};

	reg_hst3to1_int {
		compatible = "reg_hst3to1_int";
		interrupts = <0x0 0x71 0x4>;
	};

	reg_hst3to2_int {
		compatible = "reg_hst3to2_int";
		interrupts = <0x0 0x70 0x4>;
	};

	reserved-memory {
		#address-cells = <0x2>;
		#size-cells = <0x2>;
		phandle = <0x15>;
		ranges;

		cma_22 {
			compatible = "shared-dma-pool";
			heap_name = "IOMMU_DISCRETE_CMA0";
			phandle = <0xb>;
			reg = <0x0 0x2a400000 0x0 0x1000000>;
			reusable;
		};

		cma_23 {
			compatible = "shared-dma-pool";
			heap_name = "OTHERS_RETURN";
			phandle = <0xc>;
			reg = <0x0 0x53400000 0x0 0x1000000>;
			reusable;
		};

		default_cma {
			compatible = "shared-dma-pool";
			linux,cma-default;
			phandle = <0xa>;
			reg = <0x0 0x40000000 0x0 0x400000>;
			reusable;
		};

		iommu_carveout@cv0 {
			mediatek,mpu-map;
			phandle = <0x8>;
			reg = <0x0 0x48c00000 0x0 0x1400000>;
		};

		iommu_cma1@cm1 {
			phandle = <0x9>;
		};

		iommu_cma2@cm2 {
			phandle = <0x16>;
		};

		nullmem_1 {
			device_type = "mtk-nullmem";
			reg = <0x0 0x80000000 0x0 0x10000000>;
		};
	};

	sar_kp_int {
		compatible = "sar_kp_int";
		interrupts = <0x0 0xb6 0x4>;
	};

	sc_auto_bist_int {
		compatible = "sc_auto_bist_int";
		interrupts = <0x0 0xb1 0x4>;
	};

	scaler {
		compatible = "mstar-scaler";
	};

	scm_int {
		compatible = "scm_int";
		interrupts = <0x0 0x1b 0x4>;
	};

	sdio_int {
		compatible = "sdio_int";
		interrupts = <0x0 0x6 0x4>;
	};

	smart_int {
		compatible = "smart_int";
		interrupts = <0x0 0x8 0x4>;
	};

	switch_gpio {
		compatible = "mstar,switch-gpio";
		phandle = <0x82>;
		switch-gpio = <0x25>;
		switch-inverse = <0x0>;
		switch-name = "h2w";
	};

	thermal-zones {

		mtk-thermal {
			phandle = <0x89>;
			polling-delay = <0x3e8>;
			polling-delay-passive = <0x3e8>;
			thermal-sensors = <0x11 0x0>;

			cooling-maps {

				map0 {
					contribution = <0x400>;
					cooling-device = <0x2 0xffffffff 0xffffffff>;
					trip = <0x12>;
				};
			};

			trips {

				trip-point@1 {
					hysteresis = <0x3e8>;
					phandle = <0x12>;
					temperature = <0x20f58>;
					type = "passive";
				};

				trip-point@2 {
					hysteresis = <0x3e8>;
					phandle = <0x8a>;
					temperature = <0x249f0>;
					type = "hot";
				};
			};
		};
	};

	timer {
		clock-frequency = <0xb71b00>;
		compatible = "arm,mstar-timer-workaround", "arm,armv8-timer";
		interrupts = <0x1 0xd 0xff01 0x1 0xe 0xff01 0x1 0xb 0xff01 0x1 0xa 0xff01>;
	};

	tsen_0_ov_irq {
		compatible = "tsen_0_ov_irq";
		interrupts = <0x0 0xb3 0x4>;
	};

	tsen_1_ov_irq {
		compatible = "tsen_1_ov_irq";
		interrupts = <0x0 0xb4 0x4>;
	};

	tso_int {
		compatible = "tso_int";
		interrupts = <0x0 0x19 0x4>;
	};

	tsp2aeon_int {
		compatible = "tsp2aeon_int";
		interrupts = <0x0 0x4f 0x4>;
	};

	tsp2hk_int {
		compatible = "tsp2hk_int";
		interrupts = <0x0 0x10 0x4>;
	};

	tsp_auto_bist_int {
		compatible = "tsp_auto_bist_int";
		interrupts = <0x0 0xae 0x4>;
	};

	tsp_fi_queue {
		compatible = "tsp_fi_queue";
		interrupts = <0x0 0xb5 0x4>;
	};

	uart2mcu_intr {
		compatible = "uart2mcu_intr";
		interrupts = <0x0 0x32 0x4>;
	};

	uhc_int {
		compatible = "uhc_int";
		interrupts = <0x0 0x1e 0x4>;
	};

	uhc_int1 {
		compatible = "uhc_int1";
		interrupts = <0x0 0x20 0x4>;
	};

	uhc_int2 {
		compatible = "uhc_int2";
		interrupts = <0x0 0x22 0x4>;
	};

	urdma2mcu_intr {
		compatible = "urdma2mcu_intr";
		interrupts = <0x0 0x33 0x4>;
	};

	usb_int {
		compatible = "usb_int";
		interrupts = <0x0 0x1d 0x4>;
	};

	usb_int1 {
		compatible = "usb_int1";
		interrupts = <0x0 0x1f 0x4>;
	};

	usb_int2 {
		compatible = "usb_int2";
		interrupts = <0x0 0x21 0x4>;
	};

	vbi_int {
		compatible = "vbi_int";
		interrupts = <0x0 0x1c 0x4>;
	};

	vdmcu2hk_int {
		compatible = "vdmcu2hk_int";
		interrupts = <0x0 0x57 0x4>;
	};

	ve_done_TT_irq {
		compatible = "ve_done_TT_irq";
		interrupts = <0x0 0x58 0x4>;
	};

	ve_int {
		compatible = "ve_int";
		interrupts = <0x0 0x11 0x4>;
	};

	ve_vbi_f0_int {
		compatible = "ve_vbi_f0_int";
		interrupts = <0x0 0x55 0x4>;
	};

	ve_vbi_f1_int {
		compatible = "ve_vbi_f1_int";
		interrupts = <0x0 0x56 0x4>;
	};

	vivaldi_auto_bist_int {
		compatible = "vivaldi_auto_bist_int";
		interrupts = <0x0 0xac 0x4>;
	};

	vivaldi_pts_intr {
		compatible = "vivaldi_pts_intr";
		interrupts = <0x0 0x51 0x4>;
	};

	vivaldi_str_intr {
		compatible = "vivaldi_str_intr";
		interrupts = <0x0 0x50 0x4>;
	};

	wadr_err_int {
		compatible = "wadr_err_int";
		interrupts = <0x0 0x39 0x4>;
	};

	xc {
		compatible = "mstar-xc";
	};

	xiu_timeout_int {
		compatible = "xiu_timeout_int";
		interrupts = <0x0 0x53 0x4>;
	};
};
